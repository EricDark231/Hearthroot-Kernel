## drivers/kernelsu/Kconfig.susfs
```kconfig
config KSU_SUSFS
    bool "Hearthroot SUSFS compatibility"
    depends on KSU && THREAD_INFO_IN_TASK && 64BIT
    default y
    help
      Enable SUSFS integration with the FinaSU root engine.

menu "KernelSU - SUSFS"
    depends on KSU_SUSFS

comment "------------------------WARNING-------------------------------"
comment "BakaSU will check EVERY hooks in kernel compile process"
comment "If anything mismatch with simonpunk's patch, Kernel compile maybe FAILED!"
comment "See simonpunk's original patch if you face any compile failed due to hook check"
comment "Repo: https://gitlab.com/simonpunk/susfs4ksu"
comment "--------------------------------------------------------------"
config KSU_SUSFS_SUS_PATH
    bool "Enable to hide suspicious path"
    depends on KSU_SUSFS
    default y
    help
        - Allow hiding the user-defined path and all its sub-paths from various system calls.
        - Use "add_sus_path_loop" instead of "add_sus_path" if the user-defined path is frequently modified.
        - Use with caution, as it may cause performance loss and be vulnerable to side-channel attacks.
          just disable this feature if it doesn't work for you or you don't need it at all.
        - Effective only on zygote spawned user app process with uid >= 10000.

config KSU_SUSFS_SUS_MOUNT
    bool "Enable to hide suspicious mounts"
    depends on KSU_SUSFS
    default y
    help
        - Automatically assign fake mnt_id and fake mnt_group_id for mounts mounted by ksu process until /sdcard is decrypted, this is to evade from mnt_id/mnt_group_id gap detections.
        - Allow hiding all sus mounts from /proc/self/[mounts|mountinfo|mountstat] for non-su processes.

config KSU_SUSFS_SUS_KSTAT
    bool "Enable to spoof suspicious kstat"
    depends on KSU_SUSFS
    default y
    help
        - Allow spoofing the kstat of user-defined file/directory.
        - Effective only on zygote spawned user app process with uid >= 10000.

config KSU_SUSFS_SPOOF_UNAME
    bool "Enable to spoof uname"
    depends on KSU_SUSFS
    default y
    help
        - Allow spoofing the string returned by uname syscall to user-defined string.
        - Effective on all processes.

config KSU_SUSFS_ENABLE_LOG
    bool "Enable logging susfs log to kernel"
    depends on KSU_SUSFS
    default y
    help
        - Allow logging susfs log to kernel, uncheck it to completely disable all susfs log.

config KSU_SUSFS_HIDE_KSU_SUSFS_SYMBOLS
    bool "Enable to automatically hide ksu and susfs symbols from /proc/kallsyms"
    depends on KSU_SUSFS
    default y
    help
        - Automatically hide ksu and susfs symbols from '/proc/kallsyms'.
        - Effective on all processes.

config KSU_SUSFS_SPOOF_CMDLINE_OR_BOOTCONFIG
    bool "Enable to spoof /proc/bootconfig (gki) or /proc/cmdline (non-gki)"
    depends on KSU_SUSFS
    default y
    help
        - Spoof the output of /proc/bootconfig (gki) or /proc/cmdline (non-gki) with a user-defined file.
        - Effective on all processes.

config KSU_SUSFS_OPEN_REDIRECT
    bool "Enable to redirect a path to be opened with another path (experimental)"
    depends on KSU_SUSFS
    default y
    help
        - Allow redirecting a target path to be opened with another user-defined path.
        - Please be reminded that process with open access to the target and redirected path can be detected.
        - Effective only on processes with uid < 2000.

config KSU_SUSFS_SUS_MAP
    bool "Enable hiding some mmapped real files from different proc maps interfaces"
    depends on KSU_SUSFS
    default y
    help
        - Allow hiding mmapped real files from /proc/<pid>/[maps|smaps|smaps_rollup|map_files|mem|pagemap]
        - It does NOT support hiding anon memory.
        - It does NOT hide any inline hooks or PLT hooks caused by the injected library itself.
        - It may not be able to evade detections by apps that implement a good injection detection.
        - Effective only on zygote spawned umounted user app process >= 10000.

endmenu
```
